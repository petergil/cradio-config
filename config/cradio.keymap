// Copyright (c) 2022 The ZMK Contributors
// SPDX-License-Identifier: MIT
//
// Layers/behaviors/combos/chars are provided by the petergil-zmk-keymap
// module (https://github.com/petergil/zmk-keymap), pulled in via west.
// See that repo's README for the required include order and dependencies.

#include <behaviors.dtsi>
#include <dt-bindings/zmk/keys.h>
#include <dt-bindings/zmk/bt.h>
#include <dt-bindings/zmk/pointing.h>

#define HOST_OS 1  // Linux
#include "petergil-zmk-keymap/keymap.dtsi"
